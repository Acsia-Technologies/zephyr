## boards/nxp/s32k144_q100_eval/Kconfig.defconfig
```kconfig
# Copyright 2023 NXP
# SPDX-License-Identifier: Apache-2.0
#
#
#	Required target SOC was PS32K144HFT0VLLT
#	But wasnt declared in the HAL
#	According to datasheet the following were assumed to be compatible
#
#	Compatible  by datasheet -> xS32k144H(F/A)xxLLx
#	Hence chose FS32K144HAT0MLLT which closely resembles the required target SOC


if BOARD_S32K144_Q100_EVAL

config BOARD
	default "s32k144_q100_eval"

if CAN

config GPIO
	default y

endif # CAN


endif # BOARD_S32K144_Q100_EVAL
```

## boards/nxp/s32k144_q100_eval/Kconfig.s32k144_q100_eval
```kconfig
# Copyright 2023 NXP
# SPDX-License-Identifier: Apache-2.0
#
#
#	Required target SOC was PS32K144HFT0VLLT
#	But wasnt declared in the HAL
#	According to datasheet the following were assumed to be compatible
#
#	Compatible  by datasheet -> xS32k144H(F/A)xxLLx
#	Hence chose lo which closely resembles the required target SOC
#bool "s32k144_q100_eval"

config BOARD_S32K144_Q100_EVAL
	select SOC_S32K144
	select SOC_PART_NUMBER_FS32K144HAT0MLLT
```

## boards/nxp/s32k144_q100_eval/kconfig.s32k144_q100_eval
```kconfig
# Copyright 2023-2024 NXP
# SPDX-License-Identifier: Apache-2.0

config BOARD_S32K144_Q100_EVAL
	select SOC_S32K144
	select SOC_PART_NUMBER_FS32K144HAT0MLLT
```

## boards/nxp/s32k144_q100_eval/s32k144_q100_eval_defconfig
```kconfig
#	Required target SOC was PS32K144HFT0VLLT
#	But wasnt declared in the HAL
#	According to datasheet the following were assumed to be compatible
#
#	Compatible  by datasheet -> xS32k144H(F/A)xxLLx
#	Hence chose FS32K144HAT0MLLT which closely resembles the required target SOC


CONFIG_BUILD_OUTPUT_HEX=y


# Use Systick as system clock
CONFIG_SYS_CLOCK_HW_CYCLES_PER_SEC=80000000

# Run from internal program flash
CONFIG_XIP=y

# Enable MPU
CONFIG_ARM_MPU=y
CONFIG_PINCTRL=y
CONFIG_SERIAL=y
CONFIG_CONSOLE=y
CONFIG_UART_CONSOLE=y
CONFIG_GPIO=y
```

## drivers/adc/Kconfig.nxp_s32K144
```kconfig
# Copyright 2023 NXP
# SPDX-License-Identifier: Apache-2.0

config ADC_S32K144_ADC12
	bool "NXP S32 ADC SAR driver"
	default y
	depends on DT_HAS_NXP_S32K144_ADC12_ENABLED
	help
	  This option enables the NXP S32 ADC SAR driver.
```

## drivers/flash/Kconfig.nxp_s321k44
```kconfig
config SOC_FLASH_FTFC
	bool "NXP S32k flash shim driver"
	default y if SOC_S32K144
	depends on DT_HAS_NXP_KINETIS_FTFC_ENABLED
	select FLASH_HAS_PAGE_LAYOUT
	select FLASH_HAS_DRIVER_ENABLED
	select MPU_ALLOW_FLASH_WRITE if ARM_MPU
	help
	  Enables the MCUX flash shim driver.
	  WARNING: This driver will disable the system interrupts for
	  the duration of the flash erase/write operations. This will
	  have an impact on the overall system performance - whether
	  this is acceptable or not will depend on the use case.

if SOC_FLASH_FTFC

config CHECK_BEFORE_READING
	bool "Verify area before reading it"
	default y if SOC_S32K144
	help
	  Do a margin check flash command before reading an area.
	  This feature prevents erroneous/forbidden reading. Some ECC enabled
	  devices will crash when reading an erased or wrongly programmed area.

endif # SOC_FLASH_FTFC
```

## dts/bindings/adc/nxp,s32K144-adc12.yaml
```yaml
# Copyright 2023 NXP
# SPDX-License-Identifier: Apache-2.0

description: NXP S32 ADC SAR controller

compatible: "nxp,s32k144-adc12"

include: [adc-controller.yaml]

properties:
  reg:
    required: true

  interrupts:
    required: true

  vref-mv:
    type: int
    default: 3300
    description: Indicates the reference voltage of the ADC in mV.

  clk-source:
    type    : int
    required: true

  clk_divider:
    type    : int
    required: true

  group-channel:
    type: string
    enum:
      - "precision"
      - "standard"
      - "external"
    description: The ADC group channel.

  high-speed:
    type: boolean
    description: Use high speed during conversion, calibration.

  callback-select:
    type: string
    default: "normal-end-conversion"
    enum:
      - "normal-end-conversion"
      - "normal-end-chain"
    description: |
      Select normal end conversion callback to reduce interrupt handling time.
      Select normal end chain callback to reduce the number of interrupt occurrences.

  "#io-channel-cells":
    const: 1

io-channel-cells:
  - input
```

## dts/bindings/flash_controller/nxp,kinetis-ftfc.yaml
```yaml
description: NXP Kinetis Flash Memory Module A (FTFA)

compatible: "nxp,kinetis-ftfc"

include: flash-controller.yaml
```
